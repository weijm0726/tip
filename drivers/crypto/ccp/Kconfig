## drivers/crypto/ccp/Kconfig
```kconfig
config CRYPTO_DEV_CCP_CRYPTO
	tristate "Encryption and hashing offload support"
	depends on CRYPTO_DEV_SP_DD
	default m
	select CRYPTO_HASH
	select CRYPTO_BLKCIPHER
	select CRYPTO_AUTHENC
	select CRYPTO_DEV_CCP
	help
	  Support for using the cryptographic API with the AMD Cryptographic
	  Coprocessor. This module supports offload of SHA and AES algorithms.
	  If you choose 'M' here, this module will be called ccp_crypto.

config CRYPTO_DEV_SP_DD
	tristate "Secure Processor device driver"
	depends on CRYPTO_DEV_SP
	default m
	help
	  Provides the interface to use the AMD Secure Processor. The
	  AMD Secure Processor support the Platform Security Processor (PSP)
	  and Cryptographic Coprocessor (CCP). If you choose 'M' here, this
	  module will be called ccp.

if CRYPTO_DEV_SP_DD
config CRYPTO_DEV_CCP
	bool "Cryptographic Coprocessor interface"
	default y
	select HW_RANDOM
	select DMA_ENGINE
	select DMADEVICES
	select CRYPTO_SHA1
	select CRYPTO_SHA256
	help
	  Provides the interface to use the AMD Cryptographic Coprocessor
	  which can be used to offload encryption operations such as SHA,
	  AES and more.
endif
```
